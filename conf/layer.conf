## conf/layer.conf
```bitbake
#
# Copyright (C) 2016 Wind River Systems, Inc.
#
BBPATH ?= ""
# We have a conf and classes directory, add to BBPATH
BBPATH := "${LAYERDIR}:${BBPATH}"

# We have a packages directory, add to BBFILES
BBFILES := "${BBFILES} ${LAYERDIR}/recipes-*/*/*.bb \
	${LAYERDIR}/recipes-*/*/*.bbappend \
	${LAYERDIR}/classes/*.bbclass"

BBFILE_COLLECTIONS += "external-binaries"
BBFILE_PATTERN_external-binaries := "^${LAYERDIR}/"
BBFILE_PRIORITY_external-binaries = "6"

# Common licenses used by some packages in this layer
LICENSE_PATH += "${LAYERDIR}/files/common-licenses"

# This should only be incremented on significant changes that will
# cause compatibility issues with other layers
LAYERVERSION_external-binaries = "1"
```
